## config/west.yml
```yaml
manifest:
  remotes:
    - name: zmkfirmware
      url-base: https://github.com/zmkfirmware
    - name: badjeff
      url-base: https://github.com/badjeff
    - name: carrefinho
      url-base: https://github.com/carrefinho
    - name: oleksandrmaslov
      url-base: https://github.com/oleksandrmaslov      
  projects:
    - name: zmk
      remote: zmkfirmware
      revision: main
      import: app/west.yml
    - name: zmk-pmw3610-driver
      remote: badjeff
      revision: zmk-0.4
    - name: prospector-zmk-module
      remote: carrefinho
      revision: feat/new-status-screens
    - name: zmk-pointing-acceleration
      remote: oleksandrmaslov
      revision: main
  self:
    path: config
```
